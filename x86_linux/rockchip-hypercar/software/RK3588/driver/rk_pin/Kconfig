## x86_linux/rockchip-hypercar/software/RK3588/driver/rk_pin/Kconfig
```kconfig
config RT_PIN_ROCKCHIP
    bool "Rockchip GPIO support"
    depends on RT_USING_DM
    depends on RT_USING_PIN
    select RT_USING_OFW
    default n
```

## x86_linux/rockchip-hypercar/software/RK3588/driver/rk_pinctrl/Kconfig
```kconfig
config RT_PINCTRL_ROCKCHIP
    bool "Rockchip gpio and pinctrl driver"
    depends on RT_USING_PINCTRL
    select RT_MFD_SYSCON
    default n
```
