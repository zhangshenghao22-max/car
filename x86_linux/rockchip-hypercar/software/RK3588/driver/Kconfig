## x86_linux/rockchip-hypercar/software/RK3588/driver/Kconfig
```kconfig
menu "RT-Thread rockchip RK3500 drivers"

source "$BSP_DIR/driver/rk_clk/Kconfig"
source "$BSP_DIR/driver/rk_hwtimer/Kconfig"
source "$BSP_DIR/driver/rk_sdio/Kconfig"
source "$BSP_DIR/driver/rk_pwm/Kconfig"
source "$BSP_DIR/driver/rk_pin/Kconfig"
source "$BSP_DIR/driver/rk_pinctrl/Kconfig"
source "$BSP_DIR/driver/uart8250/Kconfig"
source "$BSP_DIR/driver/ivshmem/Kconfig"

endmenu
```

## x86_linux/rockchip-hypercar/software/RK3588/driver/ivshmem/Kconfig
```kconfig
menuconfig RT_USING_DRIVER_IVSHMEM
    bool "Inter-VM shared memory"
    default n

if RT_USING_DRIVER_IVSHMEM
    menuconfig RT_USING_IVSHMEM_NET
        bool "Net"
        select RT_USING_SAL
        select RT_USING_LWIP
        select RT_USING_NETDEV
        default n

    if RT_USING_IVSHMEM_NET
        config RT_USING_IVSHMEM_NET_CACHE
	        bool "Ivshmem Net using CACHE or not"
	        default n
    endif

endif
```

## x86_linux/rockchip-hypercar/software/RK3588/driver/rk_clk/Kconfig
```kconfig
config RT_CLK_ROCKCHIP_RK3588
    bool "Rockchip RK3588 clock controller support"
    select RT_USING_OFW
    select RT_USING_RESET
    default n
```

## x86_linux/rockchip-hypercar/software/RK3588/driver/rk_hwtimer/Kconfig
```kconfig
config RT_HWTIMER_ROCKCHIP
    bool "RockChip Timer"
    depends on RT_USING_DM
    select RT_USING_HWTIMER
    select RT_USING_KTIME
    default n
```

## x86_linux/rockchip-hypercar/software/RK3588/driver/rk_pwm/Kconfig
```kconfig
config RT_PWM_ROCKCHIP
    bool "Rockchip Pwm driver"
    depends on RT_USING_PWM
    default n
```

## x86_linux/rockchip-hypercar/software/RK3588/driver/rk_sdio/Kconfig
```kconfig
menuconfig BSP_USING_SDCARD
    bool "Using SD Card"
    default n

if BSP_USING_SDCARD
    config RT_SDIO_DW_MMC
        bool "Synopsys DesignWare MMC Family"
        select RT_USING_PINCTRL
        select RT_USING_RESET
        select RT_USING_DEVICE_IPC
        select RT_USING_SYSTEM_WORKQUEUE
        default n

    config RT_SDIO_DW_MMC_PCI
        bool "Synopsys Designware MCI support on PCI bus"
        depends on RT_SDIO_DW_MMC
        select RT_USING_PCI
        default n

    config RT_SDIO_DW_MMC_ROCKCHIP
        bool "Rockchip dw sdcard driver"
        depends on RT_SDIO_DW_MMC
        select RT_USING_OFW
        default y

endif
```
